/*
 Name:		Sketch1.ino
 Created:	11.11.2023 18:07:28
 Author:	emirh
*/
#include <avr/pgmspace.h>
 uint8_t anaekran1 [] PROGMEM = {
	// 'ardufon_anaekran1, 128x64px
	0x00, 0x00, 0x00, 0x00, 0x00, 0x00, 0x00, 0x00, 0x00, 0x00, 0x00, 0x00, 0x00, 0x00, 0x00, 0x00, 
	0x00, 0x00, 0x00, 0x00, 0x00, 0x00, 0x00, 0x00, 0x00, 0x00, 0x00, 0x00, 0x00, 0x00, 0x00, 0x00, 
	0x1f, 0xff, 0xff, 0xff, 0xff, 0xff, 0xff, 0xff, 0xff, 0xff, 0xff, 0xff, 0xff, 0xff, 0xff, 0xfc, 
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	0x00, 0x00, 0x00, 0x00, 0x00, 0x00, 0x00, 0x00, 0x00, 0x00, 0x00, 0x00, 0x00, 0x00, 0x00, 0x00
};
#include <OLED_I2C.h>
#include "degerler.h"
OLED ekran(SDA, SCL);
extern uint8_t SmallFont[];
extern uint8_t MediumNumbers[];
extern uint8_t TinyFont[];
extern uint8_t anaekran1[];
String kullanici = "Emirhan Ozcelik";
String anim1_goz[] = { "*  *","^  ^" };

unsigned long gecen_zaman = 0;
uint8_t snn = 0;
uint8_t sn = 0;
uint8_t dk = 21;
uint8_t saat = 14;
uint8_t buton_takip = 0;

int16_t ekran_num = 0; // 0=ana ekran , 1=saatekran , 2=pilekran ,3=rehber ...
const int sayfamax = 2; // 0 1 2 �� ekran i�in maksimum kontrol say�s�

void setup() {
	Serial.begin(9600);
	if (!ekran.begin(SSD1306_128X64))
		while (1);
	pinMode(2, INPUT_PULLUP);
	pinMode(4, INPUT_PULLUP);
	pinMode(7, INPUT_PULLUP);
	pinMode(8, INPUT_PULLUP);
	//yukleniyor("Hosgeldiniz", kullanici);
}

void loop()
{
	if (millis() - 500 > gecen_zaman)
	{
		snn++;
		sn = sn + snn % 2;
		buton_takip = 0;
		gecen_zaman = millis();
		Saat();
		ekran_guncelle(ekran_num);
	}
		uint16_t x = map(analogRead(A1), 0, 1023, 0, 5); // min=0,orta=2,max=4
		uint16_t y = map(analogRead(A0), 0, 1023, 0, 5); //tu�lar aktifken de�er =
		/*uint8_t tsl = digitalRead(2); //sol
		uint8_t tsg = digitalRead(4); //sa�
		uint8_t tas = digitalRead(7); //a�a��
		uint8_t tyk = digitalRead(8); //yukar�*/
		if (x == 0 && buton_takip == 0)
		{
			buton_takip++;
			ekran_num++;
			if (ekran_num > sayfamax) { ekran_num = 0; }
			ekran.clrScr();
		}
		else if (x == 4 && buton_takip == 0)
		{
			buton_takip++;
			ekran_num--;
			if (ekran_num < 0) { ekran_num = sayfamax; }
			ekran.clrScr();
		}

}
void ekran_guncelle(byte a)
{
	if (a == 0) { anaekran(); }
	else if (a == 1) { saatekran(); }
	else if (a == 2) { pilekran(); }
	ekran.update();
}
void yukleniyor(String s, String user)
{
	ekran.setFont(SmallFont);
	ekran.clrScr();
	ekran.print(user, CENTER, 2);
	ekran.print(s, CENTER, 18);
	for (int a = 0; a < 4; a++)
	{
		for (int i = 0; i < 2; i++)
		{
			ekran.print(anim1_goz[i], CENTER, 40);
			ekran.print("-", CENTER, 54);
			delay(500);
			ekran.update();
		}
	}
	ekran.clrScr();
	ekran.update();
}
void Saat()
{
	if (sn >= 60)
	{
		sn = 0; dk++; ekran.clrScr();
		if (dk >= 60)
		{
			sn = 0; dk = 0; saat++;
			if (saat >= 24) { sn = 0; dk = 0; saat = 0; }
		}
	}
}
void anaekran()
{
	ekran.setFont(SmallFont);
	ekran.print(kullanici, LEFT, 11);
	ekran.print("ardufon_02", LEFT, 1);
	ekran.print("gelen arama = ", LEFT, 31);
	ekran.print("gelen mesaj = ", LEFT, 51);
	ekran.printNumF(0, 0, 100, 31);
	ekran.printNumF(0, 0, 100, 51);
}
void saatekran()
{
	ekran.setFont(SmallFont);
	ekran.print("SAAT", CENTER, 10);
	ekran.setFont(MediumNumbers);
	ekran.printNumF(saat, 0, 10, 40);
	ekran.printNumF(dk, 0, 50, 40);
	ekran.printNumF(sn, 0, 90, 40);
}
void pilekran()
{
	ekran.drawBitmap(0, 0, anaekran1, 128, 64);
}
